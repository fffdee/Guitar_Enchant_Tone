## MCU/tiny_nn/sdkconfig.defaults
```kconfig
# ESP32-P4 目标由 idf.py set-target esp32p4 设定
# PSRAM: 网络权重 ~596KB 必须放 PSRAM
# P4 专有: HEX(x16) 模式 + 200MHz, 缺这两行 PSRAM 初始化不起来
CONFIG_SPIRAM=y
CONFIG_SPIRAM_MODE_HEX=y
CONFIG_SPIRAM_SPEED_200M=y
CONFIG_SPIRAM_USE_MALLOC=y
CONFIG_SPIRAM_MALLOC_ALWAYSINTERNAL=8192
CONFIG_SPIRAM_TRY_ALLOCATE_WIFI_LWIP=n

# 任务栈
CONFIG_ESP_MAIN_TASK_STACK_SIZE=8192

# FATFS 长文件名 (读写 .wav 路径)
CONFIG_FATFS_LFN_HEAP=y
CONFIG_FATFS_MAX_LFN=255

# Flash 16MB (实际芯片大小; factory 分区 3M 需 >2MB)
CONFIG_ESPTOOLPY_FLASHSIZE_16MB=y
CONFIG_ESPTOOLPY_FLASHSIZE="16MB"

# 自定义分区表 (固件含 tinynn, 需较大 app 分区)
CONFIG_PARTITION_TABLE_CUSTOM=y
CONFIG_PARTITION_TABLE_CUSTOM_FILENAME="partitions.csv"

# 性能优化
CONFIG_COMPILER_OPTIMIZATION_PERF=y

# CPU 360MHz (P4 默认高性能档)
CONFIG_ESP_DEFAULT_CPU_FREQ_MHZ_360=y

# ESP-NN: P4 优化 INT8 卷积 (非 ANSI 参考实现)
CONFIG_NN_OPTIMIZED=y

# ESP-DSP: 启用 P4 RISC-V PIE 128-bit 向量优化路径
# 使 dspm_mult_f32 / dsps_dotprod_f32 等宏自动路由到 _arp4 汇编实现
CONFIG_DSP_OPTIMIZED=y

# Task WDT: xform 推理任务固定 core1 长时间计算, 会饿死 IDLE1.
# 关闭 CPU1 的 idle 看门狗检查, 避免批处理计算被误报 (非 panic, 但会刷屏).
CONFIG_ESP_TASK_WDT_TIMEOUT_S=30
CONFIG_ESP_TASK_WDT_CHECK_IDLE_TASK_CPU1=n

# Console: primary 仍保留 UART0 早期日志, 禁用 USB Serial/JTAG secondary, 原生 USB 交给 TinyUSB 复合设备
CONFIG_ESP_CONSOLE_SECONDARY_NONE=y
# CONFIG_ESP_CONSOLE_SECONDARY_USB_SERIAL_JTAG is not set
# CONFIG_ESP_CONSOLE_USB_SERIAL_JTAG_ENABLED is not set
# CONFIG_USJ_ENABLE_USB_SERIAL_JTAG is not set

# TinyUSB CDC+MSC: 同一个 ESP32-P4 原生 USB 口枚举为 COM 口 + U 盘
CONFIG_TINYUSB_CDC_ENABLED=y
CONFIG_TINYUSB_CDC_COUNT=1
CONFIG_TINYUSB_CDC_RX_BUFSIZE=512
CONFIG_TINYUSB_CDC_TX_BUFSIZE=512
CONFIG_TINYUSB_CDC_EP_BUFSIZE=512
CONFIG_TINYUSB_MSC_ENABLED=y
CONFIG_TINYUSB_MSC_BUFSIZE=8192
CONFIG_TINYUSB_MSC_MOUNT_PATH="/sdcard"
CONFIG_TINYUSB_DESC_MANUFACTURER_STRING="Espressif"
CONFIG_TINYUSB_DESC_PRODUCT_STRING="XFORM-SD"
CONFIG_TINYUSB_DESC_MSC_STRING="XFORM SD Card"
```
